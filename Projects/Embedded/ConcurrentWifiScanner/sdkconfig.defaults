## Projects/Embedded/ConcurrentWifiScanner/sdkconfig.defaults
```kconfig
CONFIG_ESP_CONSOLE_UART_BAUDRATE=115200
CONFIG_ESPTOOLPY_FLASHSIZE_4MB=y
CONFIG_ESP_TASK_WDT_EN=y
CONFIG_ESP_TASK_WDT_INIT=y
CONFIG_FREERTOS_HZ=1000
```
